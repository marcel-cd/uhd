/*
 * Copyright (c) 2018 National Instruments Corp
 *
 * SPDX-License-Identifier: GPL-2.0 OR X11
 */

/dts-v1/;
/plugin/;

#include "sdrpi-fpga.dtsi"
#include "sdrpi-common.dtsi"
#include "dma-common.dtsi"
